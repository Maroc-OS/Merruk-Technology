## drivers/net/wireless/4330/Kconfig
```kconfig
config BCM_4330_DRIVER
	bool "BCM_4330_DRIVER"

config BROADCOM_WIFI_RESERVED_MEM
	bool "Enable Wifi Static MEM"

#	depends on MMC
	---help---
	  This module adds support for wireless adapters based on
	  BCM4330 chipset.
	  If you choose to build a module, it'll be called bcm4330. Say M if
	  unsure.
```

## drivers/samsung/Kconfig
```kconfig
#
#
#

menuconfig SAMSUNG_MODULES
	tristate "Samsung Kernel Modules"
	default m
	help
	  Say Y to enable Samsung kernel modules. j4fs and param
	  modules are included.

menuconfig J4FS
	tristate "Samsung J4FS support"
	depends on SAMSUNG_MODULES
	default m
	help
	  Say Y to enable Samsung J4FS support.

menuconfig VIBETONZ
	tristate "Vibetonz"
	depends on SAMSUNG_MODULES
	default m
	help
	  Say Y to enable Vibetonz support.
```

## drivers/video/broadcom/bmem_wrapper/Kconfig
```kconfig
config BMEM_WRAP
	tristate "Wrapper for Broadcom Unified Memory Allocater"
	default N
	---help---
		Broadcom Unified Memory Allocator device driver support
```

## drivers/video/broadcom/dss/Kconfig
```kconfig
menuconfig BCM_DSS
        bool "Broadcom Display Subsystem support (EXPERIMENTAL)"
	default N
        help
          Broadcom Display Subsystem support.

if BCM_DSS

config BCM215XX_DSS
        bool "BCM215XX Display Subsystem support (EXPERIMENTAL)"
        depends on ARCH_BCM215XX
	default y
        help
          BCM215XX Display Subsystem support.

config LCD_FRAME_INVERSION_DURING_CALL
        bool "BCM215XX LCD frame inversion during call"
	default N
        help
          BCM215XX LCD frame inversion during call.
          
endif
```

## drivers/video/broadcom/ge/gememalloc_wrapper/Kconfig
```kconfig
config GE_WRAP
	tristate "Wrapper for GE Memory Allocater"
	default N
	---help---
		GE device driver support
```

## drivers/video/broadcom/hantro/memalloc_wrapper/Kconfig
```kconfig
config HANTRO_WRAP
	tristate "Wrapper for Hantro Memory Allocater"
	default N
	---help---
		Hantro device driver support
```

## modules/Kconfig.priv
```kconfig
menuconfig BRCM_MODULES_PRIV
	tristate "Broadcom Proprietary Kernel Modules"
	depends on BRCM_MODULES
	default N
	help
	  Broadcom Proprietary Kernel Modules

if BRCM_MODULES_PRIV

# source Kconfig for proprietary drivers here
# add "depends on BRCM_MODULES && BRCM_MODULES_PRIV" to Kconfig
source "../modules/drivers/video/bmem/Kconfig"
source "../modules/drivers/video/hantro/Kconfig"
source "../modules/drivers/video/ge/Kconfig"

source "../modules/drivers/char/brcm/hal_cam/Kconfig"
source "../modules/drivers/char/brcm/camacq/Kconfig"

source "../modules/drivers/char/sec/dpram/Kconfig"

source "../modules/drivers/char/brcm/fuse_ipc/Kconfig"
source "../modules/drivers/char/brcm/fuse_net/Kconfig"
source "../modules/drivers/char/brcm/fuse_at/Kconfig"
source "../modules/drivers/char/brcm/fuse_ril/Kconfig"
source "../modules/drivers/char/brcm/fuse_pdp/Kconfig"
source "../modules/drivers/char/brcm/fuse_rpc/Kconfig"
source "../modules/drivers/char/brcm/fuse_log/Kconfig"
source "../modules/drivers/char/brcm/fuse_sysparm/Kconfig"
source "../modules/drivers/char/brcm/fuse_vsp/Kconfig"
source "../modules/drivers/char/brcm/xscript/Kconfig"
source "../modules/drivers/char/brcm/v3d/Kconfig"

source "../modules/drivers/sound/brcm/alsa/Kconfig"
source "../modules/drivers/sound/brcm/alsa_athena/Kconfig"
# Headset module
source "../modules/drivers/sound/brcm/headset/Kconfig"
source "../modules/drivers/gps/brcm/Kconfig"

# video telephony
config VIDEO_TELEPHONY_ENABLE
	boolean "Video Telephony support"
	depends on BRCM_MODULES && BRCM_MODULES_PRIV
	default N
	help
	  Video Telephony support

#OEM RIL
config OEM_RIL_ENABLE
	boolean "OEM RIL support"
	depends on BRCM_MODULES && BRCM_MODULES_PRIV
	default N
	help
	  OEM RIL support

# AGPS control plane 
config BRCM_AGPS_CONTROL_PLANE_ENABLE
	boolean "AGPS control plane support"
	depends on BRCM_MODULES && BRCM_MODULES_PRIV
	default N
	help
	  AGPS control plane support

endif # BRCM_MODULES_PRIV
```

## modules/drivers/char/brcm/camacq/Kconfig
```kconfig
config VIDEO_CAMACQ
	tristate "Camacq sensor support"
	depends on I2C
	depends on BRCM_MODULES && BRCM_MODULES_PRIV
	default y
	---help---
	  This is I2c and a Video4Linux2 sensor-level driver for the camacq.
	  
```

## modules/drivers/char/brcm/fuse_ipc/Kconfig
```kconfig
config BRCM_FUSE_IPC_CIB
	#tristate "Broadcom FUSE IPC drivers CIB"
	boolean "Broadcom FUSE IPC drivers CIB"
	depends on BRCM_MODULES && BRCM_MODULES_PRIV
	default N
	---help---
	  Broadcom FUSE IPC drivers CIB
```

## modules/drivers/char/brcm/fuse_pdp/Kconfig
```kconfig
config BRCM_FUSE_PDP_CIB
	#tristate "Broadcom FUSE PDP drivers CIB"
	boolean "Broadcom FUSE PDP drivers CIB"
	depends on BRCM_MODULES && BRCM_MODULES_PRIV
	default N
	---help---
	  Broadcom FUSE PDP drivers CIB
```

## modules/drivers/char/brcm/fuse_ril/Kconfig
```kconfig
config BRCM_FUSE_RIL_CIB
	#tristate "Broadcom FUSE RIL drivers CIB"
	boolean "Broadcom FUSE RIL drivers CIB"
	depends on BRCM_MODULES && BRCM_MODULES_PRIV
	default N
	---help---
	  Broadcom FUSE RIL drivers CIB

config BRCM_SIM_SECURE_ENABLE
	boolean "Broadcom SIM Secure Enable"
	depends on BRCM_MODULES && BRCM_MODULES_PRIV
	default N
	---help---
	  Broadcom SIM Secure Enable
```

## modules/drivers/char/brcm/hal_cam/Kconfig
```kconfig
config BRCM_HAL_CAM
	bool "Broadcom Camera HAL Driver"
	depends on I2C
	depends on BRCM_MODULES && BRCM_MODULES_PRIV
	default Y
	---help---
	  Broadcom Camera HAL Driver


config BRCM_HAL_CAM_WITH_STILL_YUV
	bool "Broadcom Camera HAL Driver for still YUV sensor "
	depends on I2C
	depends on BRCM_MODULES && BRCM_MODULES_PRIV
	default Y
	---help---
	  Broadcom Camera HAL Driver for still YUV sensor

config BCM_CAM_MT9T111
	bool "Camera MT9T111"
	depends on BRCM_HAL_CAM
	default N
	---help---
	Camera driver for MT9T111

config BCM_CAM_STV0986
	bool "Camera STV0986"
	depends on BRCM_HAL_CAM
	depends on BOARD_EXPLORER || ARCH_BCM2153
	default N
	---help---
	Camera driver for STV0986

config BCM_CAM_STV0987
        bool "Camera STV0987"
        depends on BRCM_HAL_CAM
        depends on ARCH_BCM21553_B0
        default N
        ---help---
        Camera driver for STV0987

config BCM_CAM_SR200PC10
        bool "Camera SR200PC10"
        depends on BRCM_HAL_CAM
        default Y
        ---help---
        Camera driver for SR200PC10

config BCM_CAM_ISX005
        bool "Camera ISX005"
        depends on BRCM_HAL_CAM
        default Y
        ---help---
        Camera driver for ISX005

config BCM_CAM_S5K5CCGX
        bool "Camera S5K5CCGX"
        depends on BRCM_HAL_CAM
        default Y
        ---help---
        Camera driver for S5K5CCGX

config BCM_CAM_S5K4ECGX
        bool "Camera S5K4ECGX"
        depends on BRCM_HAL_CAM
        default Y
        ---help---
        Camera driver for S5K4ECGX

config CAM_CSI2
	bool "CSI2 interface for STV0987"
	depends on BCM_CAM_STV0987
	default N
        ---help---
        Camera host interface CSI2 for STV0987

config CAM_CPI
	bool "CPI interface for SR200PC10"
	depends on (BCM_CAM_STV0987 && !CAM_CSI2)||BCM_CAM_SR200PC10||BCM_CAM_ISX005||BCM_CAM_S5K5CCGX||BCM_CAM_S5K4ECGX
        default Y
        ---help---
        Camera host interface CPI for SR200PC10

config BCM_CAM_OV2655
	bool "Camera OV2655"
	depends on BRCM_HAL_CAM_WITH_STILL_YUV
	default N
	---help---
	Camera driver for OV2655
```

## modules/drivers/char/brcm/v3d/Kconfig
```kconfig
# V3D
config BRCM_V3D
	tristate "Broadcom OpenGL engine support"
	depends on BRCM_MODULES && BRCM_MODULES_PRIV
	default N
	config BRCM_V3D_OPT
		bool "Broadcom V3D Graphics Engine Optimized driver"
		depends on BRCM_V3D && BMEM
		default N
		help
		  Broadcom V3D Graphics Engine Optimized driver
	help
	  Broadcom OpenGL engine support
```

## modules/drivers/char/sec/dpram/Kconfig
```kconfig
# Dpram configuration
#

config DPRAM
       tristate "Using smem as dpram"
       ---help---
		Include this for using smem as dpram for communication between modem and appl.
config DPRAM_WHITELIST
       bool "Using dpram to send whitelist port infos"
       ---help---
		Include this for using whitelist.
```

## modules/drivers/video/bmem/Kconfig
```kconfig
# BMEM
config BMEM
	tristate "BMEM support"
	depends on BRCM_MODULES && BRCM_MODULES_PRIV && BMEM_WRAP
	default Y
	help
		Broadcom Unified Memory Allocator device driver support
```
