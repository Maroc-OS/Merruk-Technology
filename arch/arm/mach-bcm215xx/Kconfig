## arch/arm/mach-bcm215xx/Kconfig
```kconfig
menu "Broadcom BCM215XX Implementations"
	depends on ARCH_BCM215XX

comment "BCM215XX Core Type"

choice
	prompt "Silicon version selection in BCM21553 family of devices"
	depends on ARCH_BCM215XX
	default ARCH_BCM21553_A0

config ARCH_BCM21553_A0
	bool "BCM21553 A0 based system"

config ARCH_BCM21553_B0
	select ARCH_HAS_CPUFREQ
	bool "BCM21553 B0 based system"

config BCM21553_B0_V3D_HACK
	depends on ARCH_BCM21553_B0 && BRCM_V3D
	bool "Enable V3D Hack to avoid the APB slave registers getting stuck"

config ARCH_BCM21553_B1
	select ARCH_HAS_CPUFREQ
	bool "BCM21553 B1 based system"

endchoice

comment "Define for Locale"

choice
	prompt "TARGET LOCALE"
	default TARGET_LOCALE_NONE

        config TARGET_LOCALE_NONE
                bool "LOCALE NONE"
        help
                No Specific locale

	config TARGET_LOCALE_AUS_TEL
		bool "AUS TEL"
	help
		Support AUS TEL Board

	config TARGET_LOCALE_EUR_O2
		bool "EUR O2"
	help
		Support EUR O2 Board

	config TARGET_LOCALE_EUR_TMO
		bool "EUR TMO"
	help
		Support EUR TMO Board		
		
	config TARGET_LOCALE_EUR_VODA
		bool "EUR VODA"
	help
		Support EUR VODA Board				
endchoice

comment "BCM21553 Board Type"

choice
       prompt "Board selection in BCM21553 family of devices"
       depends on ARCH_BCM21553_A0 || ARCH_BCM21553_B0 || ARCH_BCM21553_B1
       default BOARD_ATHENARAY

config BOARD_ATHENARAY
	bool "Broadcom BCM21553 AthenaRay EDN10 development board"
	help
	  Configure this option to specify the whether the board used
	  for development is a BCM21553 EDN10 AthenaRay.

config BOARD_ATHENARAY_EDN20
	bool "Broadcom BCM21553 AthenaRay EDN20 development board"
	help
	  Configure this option to specify the whether the board used
	  for development is a BCM21553 EDN20 AthenaRay.

config BOARD_THUNDERBIRD
	bool "Broadcom BCM21553 Thunderbird board"
	help
	  Configure this option to specify the whether the used
	  for development is a BCM21553 Thunderbird.

config BOARD_THUNDERBIRD_EDN31
	bool "Broadcom BCM21553 Thunderbird EDN31 board"
	help
	  Configure this option to specify the whether the used
	  for development is a BCM21553 Thunderbird EDN31.

config BOARD_THUNDERBIRD_EDN5x
	bool "Broadcom BCM21553 Thunderbird EDN5x boards"
	help
	  Configure this option to specify whether the board used
	  for development is a BCM21553 Thunderbird EDN5x.

config BOARD_TOTORO
	bool "Samsung BCM2155x Totoro board"
	help
	  Configure this option to specify the whether the used
	  for development is a BCM21553 Totoro board.

config BOARD_LUISA
	bool "Samsung BCM2155x LUISA board"
	help
	  Configure this option to specify the whether the used
	  for development is a BCM21553 Luisa board.

config BOARD_TASSVE
	bool "Samsung BCM2155x TASSVE board"
	help
	  Configure this option to specify the whether the used
	  for development is a BCM21553 TassVE board.

config BOARD_COOPERVE
	bool "Samsung BCM2155x COOPERVE board"
	help
	  Configure this option to specify the whether the used
	  for development is a BCM21553 TassVE board.
	    	    
endchoice

config SDRAM_BASE_ADDR
hex "SDRAM Base address"
depends on ARCH_BCM215XX

config MM_MEMPOOL_BASE_ADDR
hex "Base address for multimedia memory"
default 0
depends on GE_WRAP
depends on ARCH_BCM215XX

config BCM21553_L2_EVCT
        default y
        depends on ARCH_BCM215XX && CACHE_L2X0
        bool "Enable L2 eviction workaround"

config BCM215XX_PM
        bool "Enable Platform power management for BCM215XX platform"
        depends on PM && ARCH_BCM215XX
        help
          Say Yes here to enable platform power management for BCM215XX platform

config ARM1136JFS_CP15_DEBUG
	bool "Enable code to debug ARM1136JF-S CP15 state save-restore"
	depends on CPU_V6
	help
	  Say Yes here to enable code to debug the CP15 register save-restore
	  during the dormant mode entry-exit sequence.

config CPU_FREQ_GOV_BCM21553
	tristate "'BCM21553' governor for BCM21553 frequency scaling"
	depends on CPU_FREQ
	help
	  Enable this cpufreq governor for BCM21553 chipset.

	  To compile this driver as a module, choose M here: the
	  module will be called cpufreq_bcm21553.

config BCM21553_CPU_IDLE_DRV
	bool "Enable CPUIDLE driver for BCM21553"
	depends on PM && ARCH_BCM215XX && CPU_IDLE
	help
	  Say Yes here to enable the cpu idle driver for BCM21553. This driver
	  enables the CPU to be moved to dormant state during system idle to
	  enable more power savings.

config BCM21553_V3D_SYNC_ENABLE
	depends on BRCM_V3D
    bool "Enable synchronization for V3D"
    default N

config HEADSET_DET_GPIO
	bool "Samsung BCM2155x LUISA 0_2 board Headset"



endmenu
```

## common/arch/arm/mach-bcm116x/Kconfig
```kconfig
choice
	prompt "BCM116X Core Type"
	depends on ARCH_BCM116X
	default ARCH_BCM2153

config ARCH_BCM1161
	bool "BCM1161 SoC based system"

config ARCH_BCM2153
	bool "BCM2153 SoC based system"

config ARCH_BCM2157
       bool "BCM2157/BCM2151B"
endchoice

choice
	prompt "Board selection in BCM2153 family of devices"
	depends on ARCH_BCM2153
	default MACH_MARTINI

config MACH_MARTINI
	bool "BCM2153 Martini Board"
	help
	  Configure this option to specify the whether the board used
	  for development is a BCM2153 MARTINI.
endchoice

choice
       prompt "Board selection in BCM2157 family of devices"
       depends on ARCH_BCM2157
       default BOARD_EXPLORER

config BOARD_BONDRAY
	bool "Board Bondray"
	help
	  Configure this option to specify the whether the board used
	  for development is a BCM2157 BONDRAY.

config BOARD_EXPLORER
	bool "Board Explorer"
	help
	  Configure this option to specify the whether the board used
	  for development is a BCM2157 Explorer.

config BOARD_BRAVA
	bool "Board Brava"
	help
	  Configure this option to specify the whether the board used
	  for development is a BCM2157 BRAVA.

config BOARD_BRAVA_EDN10
        bool "Board Brava EDN10"
        help
          Configure this option to specify the EDN version
          used on BCM2157 Brava.

config BOARD_JDSM_ORIENTED
	bool "Board JDSM_oriented"
	help
	  Configure this option to specify the whether the board used
	  for development is a BCM2157 JDSM_oriented.
endchoice

config BCM_FUSE_APPS_PROCESSOR
  bool "BCM_FUSE_APPS_PROCESSOR"
  depends on ARCH_BCM116X
  help
  Various changes required for communicating with CP.

config SDRAM_BASE_ADDR
    hex "SDRAM Base address"
    depends on ARCH_BCM116X

config BCM_RFKILL
	bool "BCM  RFkill for Bluetooth"
	depends on RFKILL || !RFKILL

menu "BCM Options"
	depends on ARCH_BCM116X || ARCH_BCMRING

endmenu

menu "BCM116X Options"
	depends on ARCH_BCM116X

config BCM215X_PM
	bool "Enable Platform power management for BCM2153/BCM2157 platform"
	depends on PM && (ARCH_BCM2153 || ARCH_BCM2157)
	help
	  Say Yes here to enable platform power management
	  for BCM2153/BCM2157 platform


endmenu
```

## common/arch/arm/plat-bcmap/Kconfig
```kconfig
if PLAT_BCMAP

choice
	prompt "Broadcom Application Processor Family"
	default ARCH_BCM116X

config ARCH_BCM116X
	select CPU_V6
	select HAVE_CLK
	select COMMON_CLKDEV
        bool "Broadcom BCM116X Family"
	help
	  Support for Broadcom 116X based systems. This runs on the ARM11
	  apps processor of the 116X and depends on a shared memory
	  interface to the ARM9 modem processor which runs the baseband
	  stack and controls some vital subsystems.

config ARCH_BCM215XX
	select CPU_V6
	select HAVE_CLK
	select COMMON_CLKDEV
        bool "Broadcom BCM215XX Family"
	help
	  Support for Broadcom 215XX based systems. This runs on the ARM11
	  apps processor of the 215XX and depends on a shared memory
	  interface to the ARM11 modem processor which runs the baseband
	  stack and controls some vital subsystems.

endchoice

if ARCH_BCM215XX
menu "Broadcom CSL and CHAL support"
config OSDAL_SUPPORT
	bool "OSDAL Support"
	default n
	help
	  The OSDAL support is enabled when CSL and CHAL is enabled in the build

config ATHENA
	bool "Athena specific support"
	default n
	help
	 This enables Athena specific configurations in CSL and CHAL
endmenu
endif
config BCM_PWM_CORE
	bool "Broadcom PWM Core"
	help
	  Enable Broadcom PWM core layer. This option is required for PWM device
	  drivers and backlight drivers.

config BCM_CPU_FREQ
	bool "CPU Frequency Scaling Driver for Broadcom Chips"
	depends on CPU_FREQ
	help
	  Enable support for cpu frequency scaling in Broadcom chips. Presently
	  this is tested only for 215xx.

config BCM_AVS
	bool "AVS (Advaptive Voltage Scaling) Driver for Broadcom Chips"
	depends on BCM_OTP
	help
	  Enable support for AVS (Advaptive Voltage Scaling) Driver in Broadcom chips. Presently
	  this is tested only for 215xx.
endif

config BCM_POWEROFF_CHARGING
	bool "Enable power off charging feature"
	default n
	help
	  Enable this feature to have poweroff charging via USB.

config CSL_SYSMAP
       bool "Enable SYSMAP driver"	
       default y
       help 
       Enable SYSMAP driver for use with RTOS code		
```

## common/drivers/haptic/Kconfig
```kconfig
menuconfig HAPTIC
	bool "HAPTIC support"
	default y
	help
	  Say Y to enalbe haptic support. It enables the haptic and controlled
	  from both userspace and kernel

if HAPTIC

config HAPTIC_CLASS
	tristate "Haptic Class Support"
	default y
	help
	  This option enables the haptic sysfs class in /sys/class/haptic.

comment "Haptic drivers"

config HAPTIC_SAMSUNG_PWM
	tristate "Haptic Support for SAMSUNG PWM-controlled motor (ISA1000)"
	default y
	depends on HAPTIC_CLASS
	help
	  This options enables support for haptic connected to GPIO lines
	  controlled by a PWM timer on SAMSUNG CPUs.

endif	# HAPTIC
```

## common/drivers/staging/frandom/Kconfig
```kconfig
config FRANDOM
	tristate "Fast pseudo-random generator"
	default N
	---help---
	Enable the frandom char device by Eli Billauer
	http://www.billauer.co.il
```

## common/drivers/staging/lzoincl/Kconfig
```kconfig
config INCLUDE_LZO
	bool "Include LZO in kernel"
	select LZO_COMPRESS
	select LZO_DECOMPRESS
	default n
	---help---
	Dummy for LZO_COMPRESS and LZO_DECOMPRESS,
	needed for the external zram module.
```

## common/drivers/video/broadcom/Kconfig
```kconfig
config FB_BCM_116X
        tristate "BCM 116X platform framebuffer support"
        depends on FB_BCM && ARCH_BCM116X
        default n

config FB_BCM_215XX
        tristate "BCM 215XX platform framebuffer support"
        depends on FB_BCM && ARCH_BCM215XX
        default n

source "drivers/video/broadcom/bmem_wrapper/Kconfig"
source "drivers/video/broadcom/dss/Kconfig"
source "drivers/video/broadcom/displays/Kconfig"
source "drivers/video/broadcom/hantro/memalloc_wrapper/Kconfig"
source "drivers/video/broadcom/ge/gememalloc_wrapper/Kconfig"
```

## common/drivers/video/broadcom/displays/Kconfig
```kconfig
menu "Broadcom Display Device Drivers"

config PANEL_MAGNA_D51E5TA7601
        tristate "Magna TrulyHVGA LCD Panel with D51E5TA7601 controller"
        default N
        help
          Magna TrulyHVGA LCD Panel with D51E5TA7601 controller

config BCM_LCD_NT35582
        tristate "LCD Panel- N35582 controller"
        default N
        help
	  WVGA LCD panel (N35582 controller)

config BCM_LCD_S6D04H0A01
        tristate "LCD Panel- S6D04H0A01 controller"
        default N
        help
	  QVGA LCD panel (S6D04H0A01 controller)

config BCM_LCD_S6D04H0A01_TASSVE
        tristate "LCD Panel- S6D04H0A01 controller"
        default N
        help
	  QVGA LCD panel (S6D04H0A01 controller)	  

config BCM_LCD_S6D05A1X31_COOPERVE
        tristate "LCD Panel- S6D04H0A01 controller"
        default N
        help
	  QVGA LCD panel (S6D04H0A01 controller)	  

config BCM_LCD_ILI9341_BOE
        tristate "LCD Panel- S6D04H0A01 controller"
        default Y
        help
	  QVGA LCD panel (BOE controller)

config BCM_LCD_ILI9341_BOE_REV05
        tristate "LCD Panel- S6D04H0A01 controller"
        default Y
        help
	  QVGA LCD panel (BOE controller)

config BCM_LCD_S6D04K1
        tristate "LCD Panel- S6D04K1 controller"
        default N
        help
	  QVGA LCD panel (S6D04H0A01 controller)
	  
config BCM_LCD_S6D04K1_LUISA_HW02
        tristate "LCD Panel- S6D04K1 controller"
        default N
        help
	  QVGA LCD panel (S6D04H0A01 controller)
	  
config BCM_LCD_R61581
        tristate "LCD Controller- R61581 controller"
        default N
        help
	  HVGA LCD panel (Renesas R61581 controller)


if BCM_LCD_NT35582 || BCM_LCD_R61581
menu "Custom display resolution"
config ENABLE_HVGA
    bool "Enable HVGA display"
    depends on BCM_LCD_NT35582
    default y
    ---help---
    Select this to enable HVGA display

config ENABLE_QVGA
    bool "Enable QVGA display"
    depends on (BCM_LCD_NT35582 || BCM_LCD_R61581) && !ENABLE_HVGA
    default n
    ---help---
    Select this to enable QVGA display
endmenu
endif

config BCM_LCD_BTG222432
        tristate "HYUNDAI BTG222432 LCD support"
        depends on MACH_MARTINI || BOARD_BONDRAY || BOARD_EXPLORER
        ---help---
         Support for HYUNDAI BTG222432 LCD
         Say Y here to enable HYUNDAI BTG222432 LCD driver
         Say m to make it a loadable module

config BCM_LCD_HX8352_DF2440V8
    tristate "Wintek HX8352 DF2440V8 LCD support"
    depends on BOARD_BRAVA || BOARD_BRAVA_EDN10
    ---help---
     Support for WINTEK HX8352 DF2440V8 LCD Driver
     Say Y here to enable Wintek HX8352 DF2440V8 LCD driver
     Say m to make it a loadable module

config BCM_LCD_HX8347_TFT1P5158
    tristate "Truely HX8347 TFT1P5158 LCD support"
     default n
    ---help---
     Support for Truely HX8347 TFT1P5158 LCD Driver
     Say Y here to enable Truely HX8347 TFT1P5158 LCD driver
     Say m to make it a loadable module

config BCM_LCD_SKIP_INIT
    bool "Skip LCD controller and panel initialization"
     default n
    ---help---
     Support for skipping LCD controller and panel initialization.
     Say Y here if bootloader does the job of initialization

config ARGB8888
    bool "Enable 24bit colour mode"
    depends on BCM_LCD_NT35582 || BCM_LCD_R61581
    default n
    ---help---
    Say Y to enable 24bit colour mode

endmenu
```

## drivers/char/broadcom/Kconfig
```kconfig
#
# Miscellaneous Broadcom device configuration
#

menu "Broadcom Miscellaneous Devices"

config BCM_AUXADC
	tristate "Aux ADC Driver"
	depends on ARCH_BCM215XX || ARCH_BCM116X
	default y
	---help---
	Aux ADC Driver driver for BCM215XX

config BCM59038_SARADC
        tristate "BCM59038 ADC driver"
        depends on MFD_BCM59038
        ---help---
        Y to get the support of BCM59038 SAR ADC device

config BCM59038_AUDIO
	tristate "BCM59038 Audio Interface Driver"
	depends on MFD_BCM59038
	---help---
	Y to get the support of BCM59038 Audio device

config BCM_LCD_BACKLIGHT
	bool "BCM LCD Backlight"
	default n
	---help---
	Y for backlight support on bcm boards

config BCM_GPIO_VIBRATOR
    bool "Support vibrator support using timed GPIO"
    depends on ANDROID_TIMED_GPIO
    default n
    ---help---
    This driver provides vibrator support using timed gpio

config BCM_PWM
      tristate "PWM Driver"
      depends on ARCH_BCM215XX || ARCH_BCM2157
      select HAVE_PWM
      default y
      ---help---
      PWM driver for BCM215XX/BCM2157

config BCM_GPIO_VIBRATOR
    bool "Support vibrator support using timed GPIO"
    depends on ANDROID_TIMED_GPIO
    default n
    ---help---
    This driver provides vibrator support using timed gpio

config BCM_I2SDAI
     tristate "I2S Driver"
     depends on ARCH_BCM116X || ARCH_BCM215XX
     default y
     ---help---
     I2SDAI driver for BCM2153

config I2S_TEST_ENABLE
	bool "I2s Test"
	depends on BCM_I2SDAI
	default n
	---help---
	Very Minimal Bare bones test code for checking I2S loopback. Use for debugging only!

config BCM_OTP
    tristate "OTP Driver"
    depends on ARCH_BCM116X || ARCH_BCM215XX
    default n
    ---help---
    This driver provides access to the One-Time Programmable (OTP) memory.

endmenu
```
