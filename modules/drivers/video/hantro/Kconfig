## modules/drivers/video/hantro/Kconfig
```kconfig
# Hantro
config HANTRO
	tristate "Hantro support"
 	depends on BRCM_MODULES && BRCM_MODULES_PRIV && HANTRO_WRAP
	default Y
	help
	  Hantro device driver support
```
